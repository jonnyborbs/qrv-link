## main/Kconfig.projbuild
```kconfig
menu "QRV Link"

    config QRV_LINK_BLE_NAME
        string "BLE device name"
        default "QRV Link"
        help
            Name the adapter advertises to BLE-KISS apps (max 29 bytes).
            RadioMail only enables frequency control (QSY) for adapters named
            "B.B. Link"; only use that name for local experiments until it is
            coordinated with Island Magic.

    config QRV_LINK_LOG_APP_WRITES
        bool "Log every write from the app (hex)"
        default n
        help
            Log the first bytes of each write an app makes to the TX
            characteristic. Useful to see what an app sends besides KISS
            data frames.

    config QRV_LINK_LAZY_KISS
        bool "Defer the switch to KISS until the app needs it"
        default n
        help
            Stay in CAT mode when an app subscribes and switch the TNC to KISS
            on the app's first data frame, or after 3 s if it sends nothing.
            A frequency change (SetHardware 0xEA) that arrives first then
            needs no KISS exit. Listen-only apps miss packets during those 3 s.

    config QRV_LINK_STATUS_LED
        bool "Status LED (on-board addressable RGB LED)"
        default y
        help
            Off when no app is connected, blue when an app is connected,
            green flash when a packet arrives from the radio, red while a
            packet is (estimated to be) transmitting.

    config QRV_LINK_STATUS_LED_GPIO
        int "Status LED GPIO"
        depends on QRV_LINK_STATUS_LED
        default 48
        help
            ESP32-S3-DevKitC-1 v1.0 boards use GPIO48, v1.1 boards GPIO38.

    config QRV_LINK_STATUS_LED_BRIGHTNESS
        int "Status LED brightness (1-255)"
        depends on QRV_LINK_STATUS_LED
        range 1 255
        default 16

endmenu
```
